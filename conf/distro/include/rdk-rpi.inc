## conf/distro/include/rdk-rpi.inc
```bitbake
IMAGE_GEN_DEBUGFS = "0"

### preferred providers
PREFERRED_PROVIDER_libevent = "libevent"

PREFERRED_PROVIDER_virtual/iarmmgrs-hal = "iarmmgrs-hal-raspberrypi"
PREFERRED_PROVIDER_virtual/devicesettings-hal = "devicesettings-hal-raspberrypi"
PREFERRED_PROVIDER_virtual/gst-plugins-playersinkbin ?= "gst-plugins-playersinkbin-rpi"
PREFERRED_PROVIDER_virtual/wifi-hal ?= "wifi-client-hal-raspberrypi"
PREFERRED_PROVIDER_virtual/mfrlib ?= "mfrlibs-rpi"
PREFERRED_PROVIDER_virtual/mfrfwlib ?= "fwupgrade-lib"

VIRTUAL-RUNTIME_mfrlib = "mfrlibs-rpi"
VIRTUAL-RUNTIME_dtcpmgr = ""

DISTRO_FEATURES_append = " streamfs"

DISTRO_FEATURES_append = " parodus"
DISTRO_FEATURES_append = " ledmgr"
DISTRO_FEATURES_append = " build_rne"
DISTRO_FEATURES_append = " rdk-oss-ssa"

DISTRO_FEATURES_append = " ctrlm"
DISTRO_FEATURES_append = " ctrlm_voice_sdk"
DISTRO_FEATURES_append = " blercudaemon"

# Disable Thunder Security
DISTRO_FEATURES_append = " thunder_security_disable"

DISTRO_FEATURES_append = " enable_icrypto_openssl"
DISTRO_FEATURES_remove = "netflix_cryptanium"

# OCDM CAS support
DISTRO_FEATURES_append = " external-cas"

# globally disables this feature (for all images supported)
IMAGE_FEATURES_remove = "read-only-rootfs"

### preferred versions
GCCVERSION_daisy = "6.4%"

# gstreamer preferred versions
GST_VERSION_krogoth = "1.6.3"
PREFERRED_VERSION_gstreamer1.0-plugins-ugly_krogoth = "1.6.3"
PREFERRED_VERSION_gstreamer1.0-omx_krogoth = "1.2.0"

GST_VERSION_morty = "1.10.4"

GST_VERSION_dunfell = "1.16.%"
PREFERRED_VERSION_gstreamer1.0-libav_dunfell = "1.14.1"

PREFERRED_VERSION_xfsprogs_krogoth = "3.2.3"

PREFERRED_VERSION_libwebp_morty = "0.5.1"

PREFERRED_VERSION_linux-raspberrypi_morty = "4.14.%"

PREFERRED_VERSION_wayland_morty = "1.11%"
PREFERRED_VERSION_wayland-native_morty = "1.11%"

### others
ENABLE_UART = "1"

# RDKBDEV-298 : Add USP Agent support using OBUSPA
DISTRO_FEATURES_append = " usppa"

# REFPLTV-1137: DLNA support for xupnp
DISTRO_FEATURES_append = " dlna"

DISTRO_FEATURES_append = " rdkb_power_manager"
DISTRO_FEATURES_append = " rdkb_gpon_manager"
DISTRO_FEATURES_append = " rdkb_wan_manager"
DISTRO_FEATURES_append = " rdkb_voice_manager_dmltr104_v2"
DISTRO_FEATURES_append = " rdkb_xdsl_ppp_manager"
DISTRO_FEATURES_append = " fwupgrade_manager"

# RDKBDEV-50: Adding DSLite Functionality and related TR-181 DataModel Parameters
DISTRO_FEATURES_append = " dslite"

# RDKBDEV-73 : Dynamic DNS : Standardization based on broadband-forum.
DISTRO_FEATURES_append = " ddns_broadband"

# RDKBDEV-83 : Device Gateway Association using Managed Device
DISTRO_FEATURES_append = " device_gateway_association"

# REFPLTB-1546 : WiFi HAL 3.0 support for RPI
DISTRO_FEATURES_append = " halVersion3"

# RDKBDEV-866: EasyMesh Controller support
DISTRO_FEATURES_append = " easymesh-controller"

# RDKB-40900: RDKB support extender/nonrouter profile
DISTRO_FEATURES_append = " rdkb_extender"

SESSIONMGR_WS_RPC_ENABLE = "1"
```

## conf/layer.conf
```bitbake
BBPATH .= ":${LAYERDIR}"
BBFILES += "\
            ${LAYERDIR}/recipes-*/*/*.bb \
            ${LAYERDIR}/recipes-*/*/*.bbappend \
           "

BBFILE_COLLECTIONS += "cmf-raspberrypi"
BBFILE_PATTERN_cmf-raspberrypi := "^${LAYERDIR}/"
#BBFILE_PRIORITY_cmf-raspberrypi = "24"

LAYERSERIES_COMPAT_cmf-raspberrypi = "dunfell"

# do not error out on bbappends for missing recipes (mysql5)
#BB_DANGLINGAPPENDS_WARNONLY = "true"

LAYERDEPENDS_cmf-raspberrypi = "${@' cmf-broadband' if "broadband" in d.getVar('MACHINEOVERRIDES', True) else 'cmf cmf-video'}"

LAYERDEPENDS_cmf-raspberrypi_append = "${@' camera cmf-camera' if ("camera" in d.getVar('MACHINEOVERRIDES', True)) else ' '}"

LAYERDEPENDS_cmf-raspberrypi_append = " raspberrypi"

require conf/distro/include/rdk-rpi.inc
require conf/include/rdk-external-src-platform.inc

include include/rdk-bbmasks-##RDK_FLAVOR##-platform.inc

# RDK RPI builds include gstreamer ugly plugins
LICENSE_FLAGS_WHITELIST += "commercial_gstreamer1.0-plugins-ugly"
```

## conf/machine/include/tune-cortexa53.inc
```bitbake
DEFAULTTUNE ?= "cortexa53-32"

require conf/machine/include/arm/arch-armv8.inc

TUNEVALID[cortexa53] = "Enable Cortex-A53 specific processor optimizations"
TUNE_CCARGS .= "${@bb.utils.contains('TUNE_FEATURES', 'cortexa53', ' -mcpu=cortex-a53 ', '',d)}"

# Extra tune selections
AVAILTUNES += "cortexa53-32"
ARMPKGARCH_tune-cortexa53-32 ?= "cortexa53"
TUNE_FEATURES_tune-cortexa53-32 = "${TUNE_FEATURES_tune-armv7ve-neon-vfpv4} cortexa53"
BASE_LIB_tune-cortexa53-32 = "lib"
TUNE_PKGARCH_tune-cortexa53-32 = "cortexa53-32"
PACKAGE_EXTRA_ARCHS_tune-cortexa53-32 = "${PACKAGE_EXTRA_ARCHS_tune-armv7ve-neon-vfpv4} cortexa53-32"

AVAILTUNES += "cortexa53-64"
ARMPKGARCH_tune-cortexa53-64 ?= "cortexa53"
TUNE_FEATURES_tune-cortexa53-64 = "${TUNE_FEATURES_tune-aarch64} cortexa53"
BASE_LIB_tune-cortexa53-64 = "lib64"
TUNE_PKGARCH_tune-cortexa53-64 = "cortexa53-64"
PACKAGE_EXTRA_ARCHS_tune-cortexa53-64 = "${PACKAGE_EXTRA_ARCHS_tune-aarch64} cortexa53-64"
```

## conf/machine/nanopi-r1.conf
```bitbake
#@TYPE: Machine
#@NAME: nanopi-r1
#@NEEDED_BSPLAYERS: meta-sunxi meta-cmf-raspberrypi
#@DESCRIPTION: Machine configuration for running a RDK broadband on Nano Pi R1
#@RDK_FLAVOR: rdkb

MACHINEOVERRIDES .= ":nanopi-r1:raspberrypi3:rpi:broadband"

DEFAULTTUNE = "armv7vethf-neon"
require conf/machine/include/sun8i.inc

MACHINE_EXTRA_RRECOMMENDS += "\
    linux-firmware-rpidistro-bcm43430 \
    bluez-firmware-rpidistro-bcm43430a1-hcd \
"

KERNEL_DEVICETREE = "sun8i-h3-nanopi-r1.dtb"
UBOOT_MACHINE = "nanopi_r1_defconfig"

DEFAULT_OVERLAYS = "usbhost0 usbhost1 uart1"
MODULES = "g_serial"
MODULES_BLACKLIST = "lima"
BUILD_DESKTOP = "no"

# required for image creation
MACHINE_IMAGE_NAME = "rdkb-generic-broadband-image"

PREFERRED_VERSION_lighttpd_morty = "1.4.39"

SERIAL_CONSOLES = "115200;ttyS1"

DISTRO_FEATURES_append = " referencepltfm "

DISTRO_FEATURES_append_dunfell = " ipv6"
```

## conf/machine/raspberrypi-rdk-boot-time-broadband.conf
```bitbake
#@TYPE: Machine
#@NAME: raspberrypi-rdk-broadband-boot
#@NEEDED_BSPLAYERS: meta-cmf-raspberrypi
#@DESCRIPTION: Machine configuration for running a RDK broadband-boot image on Raspberry Pi
#@RDK_FLAVOR: rdkb

include conf/machine/raspberrypi3.conf

MACHINEOVERRIDES .= ":raspberrypi3:rpi:broadband:bootbroadband"

# required for image creation
MACHINE_IMAGE_NAME = "rdkb-generic-broadband-boot-image"

SERIAL_CONSOLE = "115200 ttyAMA0"

MACHINE_EXTRA_RRECOMMENDS += "kernel-module-8192eu kernel-module-rtl8812au"

PREFERRED_VERSION_readline = " 5.2"
```

## conf/machine/raspberrypi-rdk-broadband-bci.conf
```bitbake
#@TYPE: Machine
#@NAME: raspberrypi-rdk-broadband-bci
#@NEEDED_BSPLAYERS: meta-cmf-raspberrypi
#@DESCRIPTION: Machine configuration for running a RDK broadband on Raspberry Pi
#@RDK_FLAVOR: rdkb

require raspberrypi-rdk-broadband.conf

MACHINEOVERRIDES .= ":bci"

DISTRO_FEATURES_append = " bci"
DISTRO_FEATURES_append = " bci_webui_jst"

#Webui logo for BWG devices
DISTRO_FEATURES_append = " referencepltfm "
```

## conf/machine/raspberrypi-rdk-broadband-dev.conf
```bitbake
#@TYPE: Machine
#@NAME: raspberrypi-rdk-broadband
#@NEEDED_BSPLAYERS: meta-cmf-raspberrypi
#@DESCRIPTION: Machine configuration for running a RDK broadband on Raspberry Pi
#@RDK_FLAVOR: rdkb

include conf/machine/raspberrypi3.conf

MACHINEOVERRIDES .= ":raspberrypi3:rpi:broadband:broadband-dev"

# required for image creation
MACHINE_IMAGE_NAME = "rdkb-rpi-broadband-dev-image"

SERIAL_CONSOLE = "115200 ttyAMA0"

MACHINE_EXTRA_RRECOMMENDS += "kernel-module-8192eu kernel-module-rtl8812au"
INCOMPATIBLE_LICENSE_remove = "GPLv3.0 GPLv3 GPL-3.0 GPLv3+ LGPLv3.0 LGPLv3 LGPL-3.0 LGPLv3+"
PREFERRED_VERSION_gmp = "6.0.0"
```

## conf/machine/raspberrypi-rdk-broadband-gwprovapp.conf
```bitbake
#@TYPE: Machine
#@NAME: raspberrypi-rdk-broadband-gwprovapp
#@NEEDED_BSPLAYERS: meta-cmf-raspberrypi
#@DESCRIPTION: Machine configuration for running a RDK broadband on Raspberry Pi
#@RDK_FLAVOR: rdkb

require raspberrypi-rdk-broadband.conf

MACHINEOVERRIDES .= ":gwprovapp"

DISTRO_FEATURES_remove = "rdkb_power_manager"
DISTRO_FEATURES_remove = "rdkb_gpon_manager"
DISTRO_FEATURES_remove = "rdkb_wan_manager"
DISTRO_FEATURES_remove = "rdkb_voice_manager_dmltr104_v2"
DISTRO_FEATURES_remove = "rdkb_xdsl_ppp_manager"
DISTRO_FEATURES_remove = "fwupgrade_manager"
```

## conf/machine/raspberrypi-rdk-broadband-musl.conf
```bitbake
#@TYPE: Machine
#@NAME: raspberrypi-rdk-broadband-musl
#@NEEDED_BSPLAYERS: meta-cmf-raspberrypi
#@DESCRIPTION: Machine configuration for running a RDK broadband on Raspberry Pi
#@RDK_FLAVOR: rdkb

require raspberrypi-rdk-broadband.conf

TCLIBC = "musl"
```

## conf/machine/raspberrypi-rdk-broadband.conf
```bitbake
#@TYPE: Machine
#@NAME: raspberrypi-rdk-broadband
#@NEEDED_BSPLAYERS: meta-cmf-raspberrypi
#@DESCRIPTION: Machine configuration for running a RDK broadband on Raspberry Pi
#@RDK_FLAVOR: rdkb

include conf/machine/raspberrypi3.conf

MACHINEOVERRIDES .= ":raspberrypi3:rpi:broadband"

# required for image creation
MACHINE_IMAGE_NAME = "rdkb-generic-broadband-image"

PREFERRED_VERSION_lighttpd_morty = "1.4.39"

SERIAL_CONSOLE = "115200 ttyAMA0"

MACHINE_EXTRA_RRECOMMENDS += "kernel-module-8192eu kernel-module-rtl8812au kernel-module-88x2bu"

DISTRO_FEATURES_append = " referencepltfm "

DISTRO_FEATURES_append_dunfell = " ipv6"
```

## conf/machine/raspberrypi-rdk-extender-rpi4.conf
```bitbake
#@TYPE: Machine
#@NAME: raspberrypi-rdk-extender-rpi4
#@NEEDED_BSPLAYERS: meta-cmf-raspberrypi
#@DESCRIPTION: Machine configuration for running a RDK Extender on Raspberry Pi 4
#@RDK_FLAVOR: rdkb

include conf/machine/raspberrypi4.conf

MACHINEOVERRIDES .= ":raspberrypi4:rpi:broadband:extender"

# required for image creation
MACHINE_IMAGE_NAME = "rdk-generic-extender-image"

SERIAL_CONSOLE = "115200 ttyAMA0"

#MACHINE_EXTRA_RRECOMMENDS += "kernel-modules linux-firmware-bcm43430 linux-firmware-bcm43455"
MACHINE_EXTRA_RRECOMMENDS += "kernel-module-8192eu kernel-module-rtl8812au kernel-module-88x2bu"

KERNEL_IMAGETYPE = "zImage"

#IMAGE_BOOT_FILES = "bcm2835-bootfiles/* ${KERNEL_IMAGETYPE};${SDIMG_KERNELIMAGE}"
IMAGE_BOOT_FILES = "bcm2711-rpi-4-b.dtb bootfiles/* ${KERNEL_IMAGETYPE};${SDIMG_KERNELIMAGE}"

KERNEL_DEFCONFIG ?= "bcm2711_defconfig"

DISTRO_FEATURES_append = " referencepltfm "
DISTRO_FEATURES_append = " extender"

PREFERRED_PROVIDER_hal-wifi = "hal-wifi-cfg80211"

do_image_wic[depends] += " rpi-config:do_deploy"

require conf/include/rdk-bbmasks-rdkb-extender-platform.inc
```

## conf/machine/raspberrypi-rdk-hybrid-generic.conf
```bitbake
#@TYPE: Machine
#@NAME: raspberrypi-rdk-hybrid-generic
#@NEEDED_BSPLAYERS: meta-cmf-raspberrypi
#@DESCRIPTION: Machine configuration for running a RDK image on Raspberry Pi
#@RDK_FLAVOR: rdkv

require conf/machine/raspberrypi3.conf

MACHINEOVERRIDES .= ":raspberrypi3:rpi:hybrid"
MACHINE_IMAGE_NAME = "rdk-generic-hybrid-image"

DISTRO_FEATURES_append = " wifi bluez5 bluetooth"
```

## conf/machine/raspberrypi-rdk-hybrid-voice.conf
```bitbake
#@TYPE: Machine
#@NAME: raspberrypi-rdk-hybrid-voice
#@NEEDED_BSPLAYERS: meta-raspberrypi
#@DESCRIPTION: Machine configuration for running a RDK media server (hybrid) on Raspberry Pi
#@RDK_FLAVOR: rdkv

require raspberrypi-rdk-hybrid-generic.conf

MACHINEOVERRIDES .= ":wpe:voice"

# required for image creation
MACHINE_IMAGE_NAME = "rdk-generic-hybrid-voice-image"

DISTRO_FEATURES_append = " rdkshell offline_apps"
DISTRO_FEATURES_append = " cobalt-plugin"
# no more onscreen terminal required for RDK services
DISTRO_FEATURES_append = " systemd-disable-getty"
# for spark
DISTRO_FEATURES_append = " spark"
# for voice
DISTRO_FEATURES_append = " enable-rdkv-bt-voice"
# For 5.10 linux kernel
PREFERRED_VERSION_linux-raspberrypi_dunfell += "5.10.%"
PREFERRED_VERSION_linux-libc-headers_dunfell += "5.10.%"
```

## conf/machine/raspberrypi-rdk-hybrid.conf
```bitbake
#@TYPE: Machine
#@NAME: raspberrypi-rdk-hybrid
#@NEEDED_BSPLAYERS: meta-raspberrypi
#@DESCRIPTION: Machine configuration for running a RDK media server (hybrid) on Raspberry Pi
#@RDK_FLAVOR: rdkv

require raspberrypi-rdk-hybrid-generic.conf

MACHINEOVERRIDES .= ":wpe"

# required for image creation
MACHINE_IMAGE_NAME = "rdk-generic-hybrid-wpe-image"

DISTRO_FEATURES_append = " rdkshell offline_apps"
DISTRO_FEATURES_append = " cobalt-plugin"
# no more onscreen terminal required for RDK services
DISTRO_FEATURES_append = " systemd-disable-getty"
# for spark
DISTRO_FEATURES_append = " spark"
```

## conf/machine/raspberrypi-rdk-ipmc.conf
```bitbake
#@TYPE: Machine
#@NAME: raspberrypi-rdk-ipmc
#@NEEDED_BSPLAYERS: meta-raspberrypi
#@DESCRIPTION: Machine configuration for running a RDK IP client (STB) on Raspberry Pi 3B+
#@RDK_FLAVOR: rdkv

require conf/machine/raspberrypi3.conf

MACHINEOVERRIDES .= ":raspberrypi3:rpi:client:wpe:ipclient"

# enable IP STB client distro feature
DISTRO_FEATURES_append = " ipclient"

# RDKShell distro is enabled for RDK services
DISTRO_FEATURES_append = " rdkshell offline_apps"
DISTRO_FEATURES_append = " cobalt-plugin"
DISTRO_FEATURES_append = " wifi bluetooth bluez5"
DISTRO_FEATURES_append = " parodus"
DISTRO_FEATURES_append = " ledmgr"
DISTRO_FEATURES_append = " build_rne"

# no more onscreen terminal required for RDK services
DISTRO_FEATURES_append = " systemd-disable-getty"

# Disable Thunder Security
DISTRO_FEATURES_append = " thunder_security_disable"

# this can be removed if cc is open sourced
CLOSEDCAPTION = ""

# disables this feature will allow to edit files in rootfs
IMAGE_FEATURES_remove = "read-only-rootfs"

# required for image creation
MACHINE_IMAGE_NAME = "rdk-generic-ip-stb-client"

BBMASK .= "|meta-cmf-restricted/recipes-extended/mediastreamer"
BBMASK .= "|meta-cmf-restricted/recipes-extended/mediaframework"
BBMASK .= "|meta-dvb/recipes-extended/mediastreamer"
BBMASK .= "|meta-dvb/recipes-extended/mediaframework"
BBMASK .= "|meta-cmf-video-restricted/recipes-extended/rmfstreamer"
BBMASK .= "|meta-cmf-raspberrypi-restricted/meta-rdk-restricted/recipes-extended/mediastreamer"
BBMASK .= "|meta-cmf-raspberrypi-restricted/meta-rdk-restricted/recipes-extended/mediaframework"
BBMASK .= "|meta-rdk-restricted/recipes-extended/mediastreamer"
BBMASK .= "|meta-rdk-restricted/recipes-extended/mediaframework"
BBMASK .= "|meta-rdk-restricted/recipes-raspberrypi/mediaframework"
BBMASK .= "|meta-dvb"
BBMASK .= "|meta-cmf-video/recipes-extended/audiocapturemgr"
BBMASK .= "|meta-rdk-video/recipes-extended/audiocapturemgr"
BBMASK .= "|meta-cmf-video-restricted/recipes-extended/rdkmediaplayer"
BBMASK .= "|meta-cmf-video/recipes-extended/rdkmediaplayer/rdkmediaplayer"
BBMASK .= "|meta-rdk-video/recipes-extended/rdkmediaplayer"
BBMASK .= "|meta-rdk-restricted/recipes-qt/servicemanager"
BBMASK .= "|meta-cmf-raspberrypi-restricted/meta-rdk-restricted/recipes-extended/dvrmgr"
BBMASK .= "|meta-cmf-restricted/recipes-extended/dvrmgr"
BBMASK .= "|meta-rdk-video/recipes-extended/dtcpmgr"
BBMASK .= "|meta-cmf-video/recipes-extended/dtcpmgr"
BBMASK .= "|meta-rdk-video/recipes-extended/moca-hal"
BBMASK .= "|meta-rdk-restricted/recipes-extended/dvrmgr"
BBMASK .= "|meta-cmf-video/recipes-extended/trm"
BBMASK .= "|meta-rdk-video/recipes-extended/trm"
BBMASK .= "|meta-rdk-video/recipes-multimedia/media-utils"
BBMASK .= "|meta-cmf-video/recipes-multimedia/media-utils"

# for 5.10 kernel
PREFERRED_VERSION_linux-raspberrypi_dunfell += "5.10.%"
PREFERRED_VERSION_linux-libc-headers_dunfell += "5.10.%"
```
