## conf/machine/raspberrypi-rdk-mc.conf
```bitbake
#@TYPE: Machine
#@NAME: raspberrypi-rdk-mc
#@NEEDED_BSPLAYERS: meta-cmf-raspberrypi
#@DESCRIPTION: Machine configuration for running a RDK mediaclient on Raspberry Pi
#@RDK_FLAVOR: rdkv

require conf/machine/raspberrypi3.conf

MACHINEOVERRIDES .= ":raspberrypi3:rpi:client:wpe:lxcsecure"
# Disable lxc-container-generator warnings
DISTRO_FEATURES_NATIVE_append = " disable-lxcgen-warnings"

# RDKShell distro is enabled for RDK services
DISTRO_FEATURES_append = " rdkshell offline_apps"
DISTRO_FEATURES_append = " cobalt-plugin"
DISTRO_FEATURES_append = " wifi bluetooth bluez5"
# no more onscreen terminal required for RDK services
DISTRO_FEATURES_append = " systemd-disable-getty"

# for spark
DISTRO_FEATURES_append = " spark"

# required for image creation
MACHINE_IMAGE_NAME = "rdk-generic-mediaclient-wpe-image"

# for 5.10 kernel
PREFERRED_VERSION_linux-raspberrypi_dunfell += "5.10.%"
PREFERRED_VERSION_linux-libc-headers_dunfell += "5.10.%"
```

## conf/machine/raspberrypi3-64-rdk-broadband-musl.conf
```bitbake
#@TYPE: Machine
#@NAME: raspberrypi3-64-rdk-broadband-musl
#@NEEDED_BSPLAYERS: meta-cmf-raspberrypi
#@DESCRIPTION: Machine configuration for running a RDK broadband on Raspberry Pi 3 in 64bits
#@RDK_FLAVOR: rdkb

require raspberrypi3-64-rdk-broadband.conf

TCLIBC = "musl"
```

## conf/machine/raspberrypi3-64-rdk-broadband.conf
```bitbake
#@TYPE: Machine
#@NAME: raspberrypi3-64-rdk-broadband
#@NEEDED_BSPLAYERS: meta-cmf-raspberrypi
#@DESCRIPTION: Machine configuration for running a RDK broadband on Raspberry Pi 3 in 64bits
#@RDK_FLAVOR: rdkb

include conf/machine/raspberrypi3-64.conf

MACHINEOVERRIDES .= ":raspberrypi3-64:rpi:broadband"

# required for image creation
MACHINE_IMAGE_NAME = "rdkb-generic-broadband-image"

PREFERRED_VERSION_linux-raspberrypi_aarch64 = "4.7.%"
PREFERRED_VERSION_linux-raspberrypi_aarch64_morty = "4.14.%"

SERIAL_CONSOLE = "115200 ttyS0"
```

## conf/machine/raspberrypi3-rdk-camera.conf
```bitbake
#@TYPE: Machine
#@NAME: raspberrypi-rdk-camera
#@NEEDED_BSPLAYERS: meta-rdk-camera meta-cmf-raspberrypi
#@DESCRIPTION: Machine configuration for running a RDK Camera on Raspberry Pi
#@RDK_FLAVOR: rdkc

include conf/machine/raspberrypi3.conf

MACHINEOVERRIDES .= ":raspberrypi3:rpi:camera"

# required for image creation
MACHINE_IMAGE_NAME = "rdk-generic-camera-image"

PREFERRED_PROVIDER_virtual/kernel = "linux-raspberrypi"

PREFERRED_VERSION_lighttpd = "1.4.53"

DISTRO_FEATURES_append = "wifi bluez5 bluetooth"
```

## conf/machine/raspberrypi4-64-rdk-broadband.conf
```bitbake
#@TYPE: Machine
#@NAME: raspberrypi4-64-rdk-broadband
#@NEEDED_BSPLAYERS: meta-cmf-raspberrypi
#@DESCRIPTION: Machine configuration for running a RDK broadband on Raspberry Pi 4 in 64 bits
#@RDK_FLAVOR: rdkb
#@arch: 64

require conf/machine/raspberrypi4-64.conf

MACHINEOVERRIDES .= ":raspberrypi4-64:rpi:broadband"

# required for image creation
MACHINE_IMAGE_NAME = "rdkb-generic-broadband-image"

SERIAL_CONSOLE = "115200 ttyAMA0"

MACHINE_EXTRA_RRECOMMENDS += "kernel-module-8192eu kernel-module-rtl8812au kernel-module-88x2bu"

DISTRO_FEATURES_append = " referencepltfm "

DISTRO_FEATURES_append_dunfell = " ipv6"

PREFERRED_VERSION_linux-raspberrypi = "5.10.52"
PREFERRED_VERSION_linux-libc-headers = "5.10.52"
```

## conf/machine/raspberrypi4-64-rdk-hybrid.conf
```bitbake
#@TYPE: Machine
#@NAME: raspberrypi4-64-rdk-hybrid
#@NEEDED_BSPLAYERS: meta-raspberrypi
#@DESCRIPTION: Machine configuration for running a RDK media server (hybrid) on 64bit Raspberry Pi4
#@RDK_FLAVOR: rdkv

require conf/machine/raspberrypi4-64.conf

MACHINEOVERRIDES .= ":raspberrypi4-64:rpi:hybrid:wpe"

# required for image creation
MACHINE_IMAGE_NAME = "rdk-generic-hybrid-wpe-image"

DISTRO_FEATURES_append = " wifi"
DISTRO_FEATURES_append = " bluetooth"
DISTRO_FEATURES_append = " bluez5"
DISTRO_FEATURES_append = " rdkshell offline_apps"
#DISTRO_FEATURES_append = " cobalt-plugin"
DISTRO_FEATURES_remove = " cobalt-plugin"
# no more onscreen terminal required for RDK services
DISTRO_FEATURES_append = " systemd-disable-getty"
# for spark
DISTRO_FEATURES_append = " spark"
# for 5.10 kernel
PREFERRED_VERSION_linux-raspberrypi_aarch64 = "5.10.%"
```

## conf/machine/raspberrypi4-ext.conf
```bitbake
#@TYPE: Machine
#@NAME: RPI4
#@NEEDED_BSPLAYERS: meta-cmf-raspberrypi
#@DESCRIPTION: Machine configuration for running a RDK Extender on RPI4
#@RDK_FLAVOR: rdkb

DEFAULTTUNE ?= "cortexa7thf-neon-vfpv4"
require conf/machine/include/tune-cortexa7.inc
include conf/machine/include/rpi-base.inc

KERNEL_DEVICETREE += " \
    bcm2711-rpi-4-b.dtb \
    bcm2711-rpi-cm4.dtb \
    overlays/disable-wifi.dtbo \
    "

MACHINE_EXTRA_RRECOMMENDS += "kernel-modules linux-firmware-bcm43430 linux-firmware-bcm43455"

IMAGE_BOOT_FILES = "bcm2835-bootfiles/* ${KERNEL_IMAGETYPE};${SDIMG_KERNELIMAGE}"
IMAGE_BOOTLOADER = "bcm2711-bootfiles"

MACHINE_IMAGE_NAME = "rdkb-generic-extender-image"
TCLIBC = "glibc"

SDIMG_KERNELIMAGE ?= "kernel7l.img"
KERNEL_DEFCONFIG ?= "bcm2711_defconfig"
UBOOT_MACHINE = "rpi_4_32b_config"
MACHINEOVERRIDES .= ":broadband:extender"
SERIAL_CONSOLE ?= "115200 ttyS0"

PREFERRED_VERSION_linux-libc-headers = "4.14.22"
PREFERRED_VERSION_xfsprogs = "4.8.0"
PREFERRED_VERSION_php = "7.1.%"
PREFERRED_VERSION_php-native = "7.1.%"

KERNEL_IMAGETYPE = "zImage"

RDKCENTRAL_GITHUB_BRANCH ?= "master"
RDKCENTRAL_GITHUB_ROOT ?= "git://github.com/rdkcentral"
RDKCENTRAL_GITHUB_PROTOCOL ?= "https"

DISTRO_FEATURES_append = " extender"
```

## conf/machine/raspberrypi4-rdk-android-mc.conf
```bitbake
#@TYPE: Machine
#@NAME: raspberrypi4-rdk-mc
#@NEEDED_BSPLAYERS: meta-raspberrypi
#@DESCRIPTION: Machine configuration for running a RDK mediaclient on 32bit Raspberry Pi4
#@RDK_FLAVOR: rdkv

require  raspberrypi4-rdk-mc.conf


PREFERRED_PROVIDER_virtual/kernel = "android-raspberrypi"
DISTRO_FEATURES_append = " bluealsa"
```
