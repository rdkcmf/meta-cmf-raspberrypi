## conf/machine/raspberrypi4-rdk-broadband.conf
```bitbake
#@TYPE: Machine
#@NAME: raspberrypi-rdk-broadband-rpi4
#@NEEDED_BSPLAYERS: meta-cmf-raspberrypi
#@DESCRIPTION: Machine configuration for running a RDK broadband on Raspberry Pi 4
#@RDK_FLAVOR: rdkb

include conf/machine/raspberrypi4.conf

MACHINEOVERRIDES .= ":raspberrypi4:rpi:broadband"

# required for image creation
MACHINE_IMAGE_NAME = "rdkb-generic-broadband-image"

SERIAL_CONSOLE = "115200 ttyAMA0"

MACHINE_EXTRA_RRECOMMENDS += "kernel-module-8192eu kernel-module-rtl8812au kernel-module-88x2bu"

DISTRO_FEATURES_append = " referencepltfm "

DISTRO_FEATURES_append_dunfell = " ipv6"

#Distro feature to enable the DDNS broadband-forum standard(RDKBDEV-73)  
#DISTRO_FEATURES_append = " ddns_broadband "
```

## conf/machine/raspberrypi4-rdk-hybrid.conf
```bitbake
#@TYPE: Machine
#@NAME: raspberrypi4-rdk-hybrid
#@NEEDED_BSPLAYERS: meta-raspberrypi
#@DESCRIPTION: Machine configuration for running a RDK media server (hybrid) on 32bit Raspberry Pi4
#@RDK_FLAVOR: rdkv

require conf/machine/raspberrypi4.conf

MACHINEOVERRIDES .= ":raspberrypi4:rpi:hybrid:wpe"

# required for image creation
MACHINE_IMAGE_NAME = "rdk-generic-hybrid-wpe-image"

DISTRO_FEATURES_append = " wifi"
DISTRO_FEATURES_append = " bluetooth"
DISTRO_FEATURES_append = " bluez5"
DISTRO_FEATURES_append = " rdkshell offline_apps"
DISTRO_FEATURES_append = " cobalt-plugin"
# no more onscreen terminal required for RDK services
DISTRO_FEATURES_append = " systemd-disable-getty"
# for spark
DISTRO_FEATURES_append = " spark"

# for 5.10 kernel
PREFERRED_VERSION_linux-raspberrypi = "5.10.%"
```

## conf/machine/raspberrypi4-rdk-mc.conf
```bitbake
#@TYPE: Machine
#@NAME: raspberrypi4-rdk-mc
#@NEEDED_BSPLAYERS: meta-raspberrypi
#@DESCRIPTION: Machine configuration for running a RDK mediaclient on 32bit Raspberry Pi4
#@RDK_FLAVOR: rdkv

require conf/machine/raspberrypi4.conf

MACHINEOVERRIDES .= ":raspberrypi4:rpi:client:wpe"

# RDKShell distro is enabled for RDK services
DISTRO_FEATURES_append = " rdkshell offline_apps"
DISTRO_FEATURES_append = " cobalt-plugin"
DISTRO_FEATURES_append = " wifi bluetooth bluez5"
# no more onscreen terminal required for RDK services
DISTRO_FEATURES_append = " systemd-disable-getty"

# for spark
DISTRO_FEATURES_append = " spark"

# required for image creation
MACHINE_IMAGE_NAME = "rdk-generic-mediaclient-wpe-image"

# for 5.10 kernel
PREFERRED_VERSION_linux-raspberrypi = "5.10.%"
```

## conf/machine/raspberrypirdkbroadbandlxc.conf
```bitbake
#@TYPE: Machine
#@NAME: raspberrypi-rdk-broadband-lxc
#@NEEDED_BSPLAYERS: meta-cmf-raspberrypi
#@DESCRIPTION: Machine configuration for running a RDKB lxc image on Raspberry Pi
#@RDK_FLAVOR: rdkb

require conf/machine/raspberrypi-rdk-broadband.conf

DISTRO_FEATURES_append = " lxc-secure-containers lxc-secure-containers-br"

MACHINEOVERRIDES .= ":raspberrypi3:rpi:broadband:lxcbrc"

# required for image creation
MACHINE_IMAGE_NAME = "rdk-generic-broadband-lxc-image"

# avoid conflict with lxc patches there
BBMASK .= "|meta-rdk/recipes-core/images/add-users-groups-file-owners-and-permissions.inc"
BBMASK .= "|meta-cmf-raspberrypi/recipes-core/images/add-users-groups-file-owners-and-permissions.inc"
PREFERRED_VERSION_lxc = "2.0.6"
```

## conf/machine/raspberrypirdkhyblxc.conf
```bitbake
#@TYPE: Machine
#@NAME: raspberrypirdkhyblxc
#@NEEDED_BSPLAYERS: meta-cmf-raspberrypi
#@DESCRIPTION: Machine configuration for running a RDK media server (hybrid) on Raspberry Pi
#@RDK_FLAVOR: rdkv

require conf/machine/raspberrypi-rdk-hybrid.conf

DISTRO_FEATURES_append = " lxc-secure-containers lxc-secure-containers-video"

# required for image creation
MACHINE_IMAGE_NAME = "rdk-generic-hybrid-wpe-lxc-image"

PREFERRED_VERSION_lxc_morty   = "2.0.6"
PREFERRED_VERSION_lxc_dunfell = "4.0.6"
```

## conf/machine/raspberrypirdkhybrefapp-seven-inch-lcd.conf
```bitbake
#@TYPE: Machine
#@NAME: raspberrypirdkhybrefapp-seven-inch-lcd
#@NEEDED_BSPLAYERS: meta-raspberrypi
#@DESCRIPTION: Machine configuration for running a RDK media server (hybrid) with reference app on Raspberry Pi
#@RDK_FLAVOR: rdkv

require raspberrypirdkhybrefapp.conf

# for 7-inch display
DISTRO_FEATURES_append = " seven-inch-display"
```

## conf/machine/raspberrypirdkhybrefapp.conf
```bitbake
#@TYPE: Machine
#@NAME: raspberrypirdkhybrefapp
#@NEEDED_BSPLAYERS: meta-cmf-raspberrypi
#@DESCRIPTION: Machine configuration for running a RDK media server (hybrid) with reference app on Raspberry Pi
#@RDK_FLAVOR: rdkv

require conf/machine/raspberrypi3.conf

MACHINEOVERRIDES .= ":raspberrypi3:rpi:hybrid:wpewesteros:refApp"

DISTRO_FEATURES_append = " refapp"
PACKAGECONFIG_append_pn-gst-plugins-playersinkbin-rpi = " subtec"

# for disabling getty
DISTRO_FEATURES_append = " systemd-disable-getty"

# for bluetooth
DISTRO_FEATURES_append = " bluez5 bluetooth"

# for spark
DISTRO_FEATURES_append = " spark"

# required for image creation
MACHINE_IMAGE_NAME = "rdk-generic-hybrid-refapp-image"

CFLAGS_remove_pn-gstqamtunersrc = "-DQAM_LIVE_RPI"

# Do not show 4 berries on boot
DISABLE_RPI_BOOT_LOGO = "1"

# required versions for subttxrend
PREFERRED_VERSION_wayland="1.11.%"
PREFERRED_VERSION_wayland-native="1.11.%"
PREFERRED_VERSION_wayland-protocols="1.7"
```

## conf/machine/raspberrypirdkhybriddtv.conf
```bitbake
#@TYPE: Machine
#@NAME: raspberrypi-rdk-hybrid-dtv
#@NEEDED_BSPLAYERS: meta-cmf-raspberrypi
#@DESCRIPTION: Machine configuration for running a RDK media server (hybrid) with DTV support on Raspberry Pi
#@RDK_FLAVOR: rdkv

require conf/machine/raspberrypi-rdk-hybrid.conf

MACHINEOVERRIDES .= ":dtv"

# required for image creation
MACHINE_IMAGE_NAME = "rdk-generic-hybrid-dtv-image"

DISTRO_FEATURES_remove = " refapp"
DISTRO_FEATURES_append = " dvb dtvapp"
```
